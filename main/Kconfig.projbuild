## main/Kconfig.projbuild
```kconfig
menu "Example Configuration"

    config ESP_WIFI_SSID
        string "WiFi SSID"
        default "myssid"
        help
            SSID (network name) for the example to connect to.

    config ESP_WIFI_PASSWORD
        string "WiFi Password"
        default "mypassword"
        help
            WiFi password (WPA or WPA2) for the example to use.

    config ESP_MAXIMUM_RETRY
        int "Maximum retry"
        default 5
        help
            Set the Maximum retry to avoid station reconnecting to the AP unlimited when the AP is really inexistent.
    
    config AWS_ACCESS_KEY_ID
        string "AWS Access Key ID"
        default "aws-access-key-id"
        help
            Set AWS_ACCESS_KEY_ID for kvs webrtc.
    
    config AWS_SECRET_ACCESS_KEY
        string "AWS Secret Access Key"
        default "aws-secret-access-key"
        help
            Set AWS_SECRET_ACCESS_KEY for kvs webrtc.

    config AWS_IOT_CORE_CREDENTIAL_ENDPOINT
        string "AWS Iot Core Credential Endpoint"
        default "aws-iot-core-credential-endpoint"
        help
            Set AWS_IOT_CORE_CREDENTIAL_ENDPOINT for kvs webrtc.

    config AWS_IOT_CORE_CERT
        string "AWS Iot Core Cert"
        default "aws-iot-core-cert"
        help
           Set AWS_IOT_CORE_CERT for kvs webrtc.

    config AWS_IOT_CORE_PRIVATE_KEY
        string "AWS Iot Core Private Key"
        default "aws-iot-core-private-key"
        help
           Set AWS_IOT_CORE_PRIVATE_KEY for kvs webrtc.

    config AWS_IOT_CORE_ROLE_ALIAS
        string "AWS Iot Core Role Alias"
        default "aws-iot-core-role-alias"
        help
           Set AWS_IOT_CORE_ROLE_ALIAS for kvs webrtc.

    config AWS_IOT_CORE_THING_NAME
        string "AWS Iot Core Thing Name"
        default "aws-iot-core-thing-name"
        help
           Set AWS_IOT_CORE_THING_NAME for kvs webrtc.
    
    config AWS_KVS_LOG_LEVEL
        string "AWS KVS Log Level"
        default "2"
        help
            Set AWS_KVS_LOG_LEVEL for kvs webrtc.

    config AWS_DEFAULT_REGION
        string "AWS Default Region"
        default "us-west-2"
        help
            Set AWS_DEFAULT_REGION for kvs webrtc.

    config AWS_KVS_CHANNEL
        string "AWS kvs channel"
        default "ScaryTestChannel"
        help
            Set AWS_KVS_CHANNEL for kvs webrtc.
endmenu
```
